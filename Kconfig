## task/ksched/Kconfig
```kconfig
menu "CPU scheduler"

config SCHED_FAIR_REQUEST_US
    usize "Fair/EEVDF request length (microseconds)"
    range 100 100000
    default 2000
    help
      Default wall-clock request assigned to a Fair task on first
      enqueue. Virtual deadline uses this length. Default 2 000 (2 ms).

config SCHED_RR_SLICE_US
    usize "SCHED_RR time quantum (microseconds)"
    range 1000 1000000
    default 100000
    help
      How long a SCHED_RR task may run at its priority before rotating
      to the tail of that level. Default 100 000 (100 ms).

config SCHED_RT_PERIOD_US
    usize "RT bandwidth period (microseconds)"
    range 1000 10000000
    default 1000000
    help
      Length of the RT class throttle window. Paired with
      SCHED_RT_RUNTIME_US. Default 1 000 000 (1 s).

config SCHED_RT_RUNTIME_US
    usize "RT bandwidth runtime per period (microseconds)"
    range 0 10000000
    default 950000
    help
      How much CPU the whole RT class may consume in each
      SCHED_RT_PERIOD_US window before it is throttled so Fair can
      run. Values above the period are clamped to the period.
      Default 950 000 (0.95 s). Zero throttles RT immediately.

config SCHED_DL_MIN_RUNTIME_US
    usize "SCHED_DEADLINE minimum runtime (microseconds)"
    range 1 1000000
    default 100
    help
      Smallest runtime a SCHED_DEADLINE task may request. Requests below
      this bound are rejected during attribute validation, because a
      shorter runtime cannot be accounted for meaningfully.

config SCHED_DL_BW_MARGIN_PCT
    u32 "SCHED_DEADLINE bandwidth margin (percent)"
    range 0 99
    default 5
    help
      Bandwidth kept unassigned on every run queue. A deadline task is
      admitted only when the run queue's assigned bandwidth stays at or
      below (100 - margin) percent. A smaller margin admits more deadline
      load; zero allows assignment up to a whole CPU.

endmenu
```

## task/ktask/Kconfig
```kconfig
menu "Task Scheduler"

choice
    prompt "Scheduler algorithm"
    default KFEAT_SCHED_EEVDF

config KFEAT_SCHED_FIFO
    bool "FIFO cooperative scheduler"
    help
      Use the FIFO cooperative scheduler. Tasks run to completion
      unless they explicitly yield.

config KFEAT_SCHED_RR
    bool "Round-robin preemptive scheduler"
    help
      Use the Round-robin preemptive scheduler. Each task gets a fixed
      time slice and is rotated fairly.

config KFEAT_SCHED_CFS
    bool "CFS (Completely Fair Scheduler)"
    help
      Use the Completely Fair Scheduler. Tasks are scheduled based on
      virtual runtime to ensure proportional CPU share.

config KFEAT_SCHED_EEVDF
    bool "EEVDF (Earliest Eligible Virtual Deadline First)"
    help
      Use the EEVDF scheduler. Tasks are scheduled by virtual deadline
      with eligibility checks, providing latency-sensitive fairness.

endchoice

endmenu
```

## task/ktask/Kconfig.diagnostics
```kconfig
menu "Task Diagnostics"

config KFEAT_SNAPSHOT
    bool "Task snapshot support"
    default y if BUILD_TYPE_DEBUG
    help
      Enable reusable task/CPU snapshot collection and backtrace dumping
      support in `ktask::snapshot`. Debug builds enable this by default so
      panic, watchdog, and manual diagnostic paths can collect task state.

config KFEAT_SYSRQ
    bool "SysRq task snapshot trigger"
    depends on KFEAT_SNAPSHOT
    default y if BUILD_TYPE_DEBUG
    help
      Expose `/proc/sysrq-trigger` and route supported SysRq commands to the
      shared snapshot service. Debug builds enable this by default; release
      builds can still opt in when operator-triggered diagnostics are needed.

config KFEAT_WATCHDOG
    bool "Watchdog diagnostics"
    depends on KFEAT_SNAPSHOT
    help
      Enable watchdog-driven diagnostic checks such as soft lockup detection
      and lock-wait heuristics.

config KFEAT_SCHED_STAT
    bool "Scheduler statistics"
    default y if BUILD_TYPE_DEBUG
    help
      Enable low-overhead per-CPU scheduler counters for diagnostics. The
      counters are exposed through `/proc/sched_stat`; the watchdog also
      prints them when reporting a soft lockup. Debug builds enable this by
      default, while release builds keep it opt-in.

config KFEAT_WATCHDOG_HARDLOCKUP
    bool "Watchdog hard lockup detection"
    depends on KFEAT_WATCHDOG
    depends on MACHINE_AARCH64_QEMU
    depends on KFEAT_NMI
    help
      Enable the hard lockup watchdog backend. Requires NMI support (the
      source is selected together with NMI).  On AArch64 QEMU virt this is
      currently implemented through the PMU-backed periodic NMI source and
      global snapshot rendezvous.

config KFEAT_LOCK_STAT
    bool "Lock contention statistics (/proc/lock_stat)"
    default y if BUILD_TYPE_DEBUG
    help
      Enable per-class lock contention statistics for kernel mutexes, rwlocks,
      and spinlocks. Statistics are exposed through `/proc/lock_stat`. Debug
      builds enable this by default, while release builds keep it opt-in
      because lock-path instrumentation has runtime cost.

endmenu
```
