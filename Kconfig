## drivers/Kconfig
```kconfig
menu "Drivers Basic Configuration"

config PSCI_METHOD
    string "PSCI Method"
    default "hvc"
    depends on ARCH_AARCH64
    help
      Specify the method used for Power State Coordination Interface (PSCI) calls.

config PHYS_BUS_OFFSET
    hex "Physical Bus Offset"
    default 0x0
    help
      Specify the physical bus offset for device memory mapping.

config KFEAT_PCI_NON_ECAM
    bool "Enable non-ECAM PCI discovery quirks"
    help
      Enable the PCI quirks needed on guests whose PCI fabric does not behave
      like a fully standard ECAM implementation.

config PCI_ECAM_BASE
    hex "PCI ECAM Base Address"
    default 0x40100000000
    help
      Define the base address for PCI Express Configuration Access Mechanism (ECAM).

config PCI_BUS_END
    hex "PCI Bus End"
    default 0xff
    help
      Set the end bus number for PCI devices.

config PCI_RANGES
    rangetype "PCI Address Ranges"
    default [(u64, u64)]
    help
      Specify the address ranges for PCI devices.

config BOOT_CONSOLE_TYPE
    string "Boot console transport"
    default "mmio" if ARCH_AARCH64
    default "mmio" if ARCH_RISCV64
    default "ioport" if ARCH_X86_64
    help
      Select how the boot console is accessed before the runtime console is
      initialized.
      - "mmio": BOOT_CONSOLE_ADDR is a physical MMIO base address.
      - "ioport": BOOT_CONSOLE_ADDR is a legacy x86 I/O port base.
      Set BOOT_CONSOLE_ADDR to 0 to disable boot-stage console output.

config BOOT_CONSOLE_ADDR
    hex "Boot console base address"
    default 0x0
    default 0x3f8 if ARCH_X86_64
    help
      Define the boot console base address used only for boot-time diagnostics
      before the runtime console driver is initialized.
      For BOOT_CONSOLE_TYPE="mmio", this is a physical MMIO base address.
      For BOOT_CONSOLE_TYPE="ioport", this is a legacy I/O port base.

config BOOT_CONSOLE_BAUDRATE
    hex "Boot console baud rate (bits/s)"
    default 0x0
    help
      The baud rate of the boot console UART. The early boot console (which runs
      before the runtime console driver and cannot poll the TX-ready bit) uses
      this to pace output at one byte time per character, so a fast core does not
      overrun the UART TX FIFO and drop characters. Set to 0 to disable pacing
      (emulated UARTs and PL011s with deep FIFOs do not need it). Only relevant
      for real MMIO 16550 consoles such as the RK3588 DesignWare UART.

config BOOT_CONSOLE_REG_IO_WIDTH
    usize "Boot console MMIO access width"
    default 1
    help
      The byte width used by the minimal AArch64 early boot console when it
      writes the UART data register before the runtime device-tree console
      driver is available. This mirrors the device-tree `reg-io-width`
      property for real MMIO UARTs such as the RK3588 DesignWare UART. Set to
      1 for byte accesses and 4 for 32-bit accesses.

config RTC_PADDR
    hex "RTC Base Address"
    help
      Define the base address for the RTC (Real-Time Clock) device.

menu "IRQ Configuration"

config PMU_IRQ
    usize "PMU IRQ Number"
    default 23
    depends on ARCH_AARCH64
    default 23
    depends on ARCH_AARCH64
    help
      Define the interrupt number for the Performance Monitoring Unit (PMU).

config ARM_GENERIC_TIMER_MODE
    string "ARM generic timer mode"
    depends on ARCH_AARCH64
    default "physical"
    help
      Select which architected timer view EL1 should use.
      - "physical": use CNTPCT_EL0/CNTP_* registers.
      - "virtual": use CNTVCT_EL0/CNTV_* registers.
      For virtcca-like guests where EL1 physical timer access is trapped,
      set this to "virtual".

config IPI_IRQ
    usize "IPI IRQ Number"
    default 1
    help
      Define the interrupt number for Inter-Processor Interrupts (IPI).

endmenu # IRQ Configuration

menu "Device Drivers Features"

choice
    prompt "Virtio Bus Type"
    default KFEAT_VIRTIO_BUS_PCI

config KFEAT_VIRTIO_BUS_PCI
    bool "PCI Virtio_Bus Support"
    help
      Enable PCI virtio bus support.

config KFEAT_VIRTIO_BUS_MMIO
    bool "MMIO Virtio_Bus Support"
    help
      Enable MMIO virtio bus support.

endchoice

config KFEAT_RTC
    bool "RTC (Real Time Clock) Support"
    default y
    help
      Enable Real Time Clock driver subsystem.

config KFEAT_DISPLAY
    bool "Display Driver Support"
    default y
    help
      Enable display driver support (virtio-gpu, fbdevice, etc).

config KFEAT_INPUT
    bool "Input Driver Support"
    default y
    help
      Enable input driver support (virtio-input, inputdev, etc).

config KFEAT_CHAR
    bool "Character Driver Support"
    default y
    help
      Enable runtime character device support. This covers devices that are
      exposed after early boot handoff or through the unified driver pipeline.
endmenu   # Device Drivers Features

endmenu # Drivers Basic Configuration

menu "Device Drivers"

comment "Block device drivers"

config KFEAT_DRIVER_VIRTIO_BLK
    bool "virtio-blk block device"
    depends on KFEAT_FS
    default y
    help
      Enable the virtio-blk block device driver. Required by virtio-based
      virtual platforms (QEMU/CrosVM) when a disk-backed filesystem is in use.

config KFEAT_DRIVER_RAMDISK
    bool "RAM disk block device"
    depends on KFEAT_FS
    help
      Use an in-memory RAM disk to back the filesystem. Useful on platforms
      that do not (yet) provide a real block device driver.

config KFEAT_DRIVER_RAMDISK_STATIC
    bool "Back the RAM disk with an embedded filesystem image"
    depends on KFEAT_DRIVER_RAMDISK
    help
      Populate the RAM disk from a build-time filesystem image embedded into
      the kernel, instead of an empty zero-filled region, so it can be mounted
      as a real (read-write) root filesystem. The image path is set by the
      RAMDISK_IMG Makefile variable (default: an empty ext4 image produced by
      'make ramdisk_img'); any ext4 image may be substituted. Select the
      matching filesystem backend (KFEAT_FS_EXT4 by default; KFEAT_FS_FAT if a
      FAT image is used). The image is embedded in .data, so the kernel binary
      grows by roughly the image size.

comment "Network drivers"

config KFEAT_DRIVER_VIRTIO_NET
    bool "virtio-net NIC"
    depends on KFEAT_NET
    default y
    help
      Enable the virtio-net NIC driver. Required by virtio-based virtual
      platforms (QEMU/CrosVM) when networking is in use.

config KFEAT_DRIVER_VIRTIO_SOCKET
    bool "virtio-vsock transport"
    depends on KFEAT_VSOCK
    default y
    help
      Enable the virtio-vsock transport driver used by AF_VSOCK on virtio
      platforms.

config KFEAT_DRIVER_VIRTIO_RNG
    bool "virtio-rng entropy source"
    depends on KFEAT_CHAR
    default y
    help
      Enable the virtio-rng hardware entropy source driver. Required on
      virtio-based virtual platforms (QEMU/CrosVM) when guest randomness should
      come from the VMM-provided entropy device.

config KFEAT_ENTROPY_ARCH_CPU
    bool "CPU instruction RNG (AArch64 RNDR / x86 RDSEED·RDRAND)"
    default y if ARCH_AARCH64 || ARCH_X86_64
    help
      Mix entropy from architecture CPU RNG instructions when available:
        - AArch64: RNDR / RNDRRS (Armv8.5 RNG extension)
        - x86_64: RDSEED preferred, RDRAND as fallback

      Defaults to n on architectures without a CPU RNG instruction path
      (for example RISC-V today). Kept visible on all arches so shared
      kernel crates can always reference the Kconfig constant.

      This path does not trust the VMM and is preferred on bare-metal or
      hardware-isolated deployments. VirtIO RNG remains available as a
      fallback when this option is disabled or the CPU lacks the extension
      (some QEMU CPU models).

config KFEAT_ENTROPY_SMCCC_TRNG
    bool "SMCCC firmware TRNG (ARM TRNG SMCCC 1.0)"
    default y if ARCH_AARCH64
    help
      Mix entropy from the ARM SMCCC TRNG firmware service (TRNG_RND64) when
      EL3/TF-A exposes it. Probe fails silently on platforms without the
      service, such as typical QEMU virt guests. Does not require Device Tree
      and is suitable for ACPI bare-metal platforms.

      Defaults to n on non-AArch64 architectures. Kept visible on all arches
      so shared kernel crates can always reference the Kconfig constant.

config KFEAT_ENTROPY_TRUST_HOST
    bool "Mix VirtIO RNG entropy (trust the VMM / host)"
    default y if KFEAT_DRIVER_VIRTIO_RNG
    help
      When enabled, VirtIO RNG bytes are mixed into the kernel entropy pool
      during reseed alongside CPU / SMCCC / SoC sources. This is appropriate
      for QEMU, crosvm, and other development VMs where the host provides
      randomness through virtio-rng.

      Disable this for bare-metal or isolated deployments where the VMM must
      not influence kernel randomness. VirtIO RNG may still be probed, but it
      will not participate in hardware reseed when this option is off.

      Defaults to n when VirtIO RNG is not selected. Kept visible so shared
      entropy code can always reference the Kconfig constant.

config KFEAT_ENTROPY_JITTER
    bool "Software jitter entropy (timer / interrupt timing noise)"
    default y
    help
      Mix low-rate entropy collected from timing variations during busy waits.
      Interrupts, scheduling, and cache effects perturb the measured intervals.
      Used as a fallback when HRNG sources are unavailable, and as
      supplementary input when they are.

comment "Character drivers"

config KFEAT_DRIVER_CONSOLE_PL011
    bool "PL011 UART backend (early console)"
    depends on KFEAT_CHAR && ARCH_AARCH64
    default y if MACHINE_AARCH64_QEMU
    help
      Build the PL011 UART backend used by the early-boot console and the
      per-instance serial driver.

config KFEAT_DRIVER_CONSOLE_NS16550_MMIO
    bool "NS16550 MMIO UART backend (early console)"
    depends on KFEAT_CHAR
    default y if MACHINE_AARCH64_RK3588
    default y if MACHINE_RISCV64_QEMU
    default y if MACHINE_LOONGARCH64_QEMU
    help
      Build the NS16550 MMIO UART backend used by the early-boot console and
      the per-instance serial driver.

config KFEAT_DRIVER_CONSOLE_NS16550_IOPORT
    bool "NS16550 I/O-port UART backend (early console)"
    depends on KFEAT_CHAR && ARCH_X86_64
    default y if MACHINE_X86_64_QEMU
    help
      Build the NS16550 I/O-port UART backend used by the early-boot console
      and the per-instance serial driver.

config KFEAT_DRIVER_SERIAL_PL011
    bool "PL011 per-instance serial driver"
    depends on KFEAT_CHAR && ARCH_AARCH64
    select KFEAT_DRIVER_CONSOLE_PL011
    default y if MACHINE_AARCH64_QEMU
    help
      Enable the kdriver per-instance serial driver for PL011 UARTs. Each UART
      node becomes a character device; the stdout UART shares the early-boot
      instance.

config KFEAT_DRIVER_SERIAL_NS16550_MMIO
    bool "NS16550 MMIO per-instance serial driver"
    depends on KFEAT_CHAR
    select KFEAT_DRIVER_CONSOLE_NS16550_MMIO
    default y if MACHINE_AARCH64_RK3588
    default y if MACHINE_RISCV64_QEMU
    default y if MACHINE_LOONGARCH64_QEMU
    help
      Enable the kdriver per-instance serial driver for NS16550 MMIO UARTs.

config KFEAT_DRIVER_SERIAL_NS16550_IOPORT
    bool "NS16550 I/O-port per-instance serial driver"
    depends on KFEAT_CHAR && ARCH_X86_64
    select KFEAT_DRIVER_CONSOLE_NS16550_IOPORT
    default y if MACHINE_X86_64_QEMU
    help
      Enable the kdriver per-instance serial driver for the NS16550 I/O-port
      (x86 ISA COM) UART.

comment "Filesystem transport drivers"

config KFEAT_DRIVER_VIRTIO_9P
    bool "virtio-9p transport"
    depends on KFEAT_FS_9P
    default y
    help
      Enable the virtio-9p transport used by the 9P filesystem client (e.g.
      QEMU hostshare).

comment "Display / input drivers"

config KFEAT_DRIVER_VIRTIO_GPU
    bool "virtio-gpu display"
    help
      Enable the virtio-gpu display driver.

config KFEAT_DRIVER_VIRTIO_INPUT
    bool "virtio-input input device"
    help
      Enable the virtio-input input device driver.

endmenu # Device Drivers
```

## fs/Kconfig
```kconfig
menu "File Systems"

config KFEAT_FS
    bool "Enable filesystem support"
    default y
    help
      Enable the kernel filesystem stack and related runtime support.

config KFEAT_FS_EXT4
    bool "ext4 filesystem support"
    depends on KFEAT_FS
    default y
    help
      Enable support for mounting ext4 filesystems.

config KFEAT_FS_FAT
    bool "FAT filesystem support"
    depends on KFEAT_FS
    help
      Enable support for mounting FAT filesystems.

config KFEAT_FS_TIMES
    bool "Enable filesystem timestamps"
    depends on KFEAT_FS_EXT4
    help
      Enable timestamp-related behavior in the ext4 VFS adapter.

config KFEAT_FS_9P
    bool "Enable 9P filesystem support"
    depends on KFEAT_FS
    help
      Enable the 9P filesystem client used for shared-directory mounts such as
      QEMU hostshare.

endmenu
```

## mm/Kconfig
```kconfig
menu "Memory Management"

config KFEAT_ALLOC
    bool "Enable kernel dynamic allocation"
    default y
    help
      Enable the kernel heap allocator stack. This gates allocator-related
      crates and the byte allocator implementation selection.

choice
    prompt "Kernel byte allocator"
    depends on KFEAT_ALLOC
    default KFEAT_ALLOC_SLAB

config KFEAT_ALLOC_SLAB
    bool "SLAB"
    help
      Use the slab byte allocator implementation.

config KFEAT_ALLOC_TLSF
    bool "TLSF"
    help
      Use the two-level segregated fit byte allocator implementation.

config KFEAT_ALLOC_BUDDY
    bool "Buddy"
    help
      Use the buddy-system byte allocator implementation.

endchoice

endmenu
```

## net/Kconfig
```kconfig
menu "Networking"

config KFEAT_NET
    bool "Enable networking support"
    help
      Enable the kernel networking stack and NIC driver integration.

config KFEAT_VSOCK
    bool "Enable virtio-vsock support"
    depends on KFEAT_NET
    help
      Enable AF_VSOCK support for guest and host communication.

endmenu
```

## sync/krcu/Kconfig
```kconfig
menu "RCU validation"

config KFEAT_RCU_TORTURE
    bool "Run RCU ownership stress instead of userspace"
    depends on !KFEAT_WORKQUEUE_BENCH
    default n
    help
      Explicit release-only validation after runtime initialization.
      Does not run under UNITTEST. Reports progress independently of log level
      and powers off after successful completion. Not a performance benchmark.

config RCU_TORTURE_SECONDS
    usize "RCU ownership stress duration in seconds"
    depends on KFEAT_RCU_TORTURE
    range 1 86400
    default 1800
    help
      Complete and verify whole finite batches until this duration elapses.
      Use an external timeout: a stalled batch must fail, not be abandoned.
      Boot and final batch completion may extend the total runtime.

config KFEAT_RCU_BENCH
    bool "Measure RCU read costs and wait latency instead of userspace"
    depends on !KFEAT_WORKQUEUE_BENCH && !KFEAT_RCU_TORTURE
    default n
    help
      Release-only sequential prepared submission, completion and sync waits.
      Also measures baseline, empty read scopes and scoped object read batches.
      Runs separately from torture, with one warmup and three measured rounds
      on each present CPU. Prints raw samples and powers off on completion.
      Not a throughput benchmark; do not enable UNITTEST or coverage.

endmenu
```

## task/Kconfig
```kconfig
menu "Task Scheduling and Synchronization"

source "task/ksched/Kconfig"
source "task/kworkng/Kconfig"

endmenu
```
