## xtask/xconfig/examples/sample_project/Kconfig
```kconfig
mainmenu "Sample Project Configuration"

config HAVE_ARCH
	bool
	default y

menu "Architecture Selection"

source "arch/x86/Kconfig"
source "arch/arm/Kconfig"

endmenu

menu "Kernel Configuration"

source "kernel/Kconfig"

endmenu

config DEBUG
	bool "Enable debugging"
	default n
	help
	  Enable debugging features.

config VERBOSE
	bool "Verbose output"
	depends on DEBUG
	default n
```

## xtask/xconfig/examples/sample_project/arch/arm/Kconfig
```kconfig
config ARM
	bool "ARM architecture"
    depends on HAVE_ARCH
	default n
	help
	  Support for ARM architecture.

config ARM64
	bool "64-bit ARM support"
    imply ARM
	default n
```

## xtask/xconfig/examples/sample_project/arch/x86/Kconfig
```kconfig
config X86
	bool "x86 architecture"
	default n
	help
	  Support for x86 architecture.

config X86_64
	bool "64-bit support"
	depends on X86
	default y
```

## xtask/xconfig/tests/fixtures/conditional_defaults/Kconfig
```kconfig
mainmenu "Test Conditional Defaults"

choice
    prompt "Target Architecture"
    default ARCH_AARCH64

config ARCH_AARCH64
    bool "AArch64"

config ARCH_RISCV64
    bool "RISC-V 64"

config ARCH_X86_64
    bool "x86_64"

endchoice

config ARCH
    string
    default "aarch64" if ARCH_AARCH64
    default "riscv64" if ARCH_RISCV64
    default "x86_64" if ARCH_X86_64
    default "unknown"
    help
      The name of the selected architecture.

config PLATFORM
    string
    default "qemu-virt" if ARCH_AARCH64
    default "sifive-u" if ARCH_RISCV64
    help
      Platform name based on architecture.

config DEFAULT_VALUE
    string
    default "fallback"

config NUMERIC_VALUE
    int
    default 10 if ARCH_AARCH64
    default 20 if ARCH_RISCV64
    default 5
```

## xtask/xconfig/tests/fixtures/dependency/Kconfig
```kconfig
config BASE_LIB
bool "Base library support"
default n
help
  Enable base library support required by other features.

config FEATURE_A
bool "Feature A"
depends on BASE_LIB
select HELPER_MODULE
help
  Feature A that depends on BASE_LIB and selects HELPER_MODULE.

config HELPER_MODULE
bool "Helper module"
default n
help
  Helper module that can be selected by other options.

config FEATURE_B
bool "Feature B"
imply OPTIONAL_FEATURE
help
  Feature B that implies OPTIONAL_FEATURE.

config OPTIONAL_FEATURE
bool "Optional feature"
default n
help
  Optional feature that is suggested but not required.

config TRISTATE_OPTION
tristate "Tristate option"
depends on BASE_LIB
default m
help
  A tristate option for testing.
```

## xtask/xconfig/tests/fixtures/imply_dependency/Kconfig
```kconfig
config C
bool "Enable C"
default n
help
  Base dependency.

config B
bool "Enable B"
depends on C
help
  B depends on C.

config A
bool "Enable A"
imply B
help
  A implies B.

config D
bool "Enable D"
default n

config E
bool "Enable E"
depends on D

config F
bool "Enable F"
depends on E

config G
bool "Enable G"
imply F
help
  G implies F (with deeper dependency chain).
```

## xtask/xconfig/tests/fixtures/not_operator/Kconfig
```kconfig
config PREEMPT
	bool "Preemptive kernel"
	default n
	help
	  Enable kernel preemption.

config ADVANCED_FEATURES
	bool "Advanced features"
	default y
	help
	  Enable advanced kernel features.

config SCHEDULER_RT
	bool "Real-time scheduler"
	depends on ADVANCED_FEATURES && !PREEMPT
	help
	  Enable real-time scheduler support.
	  This requires ADVANCED_FEATURES=y and PREEMPT=n

config FEATURE_A
	bool "Feature A"
	default n

config FEATURE_B
	bool "Feature B"
	depends on !FEATURE_A
	help
	  Feature B conflicts with Feature A.

config FEATURE_C
	bool "Feature C"
	depends on !(FEATURE_A && FEATURE_B)
	help
	  Complex NOT expression test.
```

## xtask/xconfig/tests/fixtures/source/Kconfig
```kconfig
mainmenu "Source Test"

config MAIN_CONFIG
	bool "Main config"
	default y

source "sub/Kconfig"
```
