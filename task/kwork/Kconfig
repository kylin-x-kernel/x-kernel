## task/kwork/Kconfig
```kconfig
menu "Kernel Workqueue"

config WORKQUEUE_PENDING_CAP
    usize "Per-pool pending work ring capacity"
    range 8 1024
    default 128
    help
      Maximum number of pending work entries one worker pool can hold.
      All logical workqueues attached to a per-CPU pool share this
      bounded ring, so capacity pressure grows with the number of
      attached queues. Enqueue into a full ring fails instead of
      blocking or allocating, keeping the enqueue path IRQ-safe.
      Raising the cap increases static memory usage by one entry slot
      per added slot per pool.

config WORKQUEUE_WORKERS_PER_POOL
    usize "Maximum worker tasks per system worker pool"
    range 1 16
    default 4
    help
      Maximum number of worker tasks one per-CPU system worker pool may
      run. IRQ-safe enqueue paths never create tasks; a per-CPU manager task
      creates workers on demand up to this cap. Raising the cap increases
      per-pool static worker records and worker wake-source storage.

config KFEAT_KWORK_STRESS
    bool "Enable workqueue procfs stress trigger"
    depends on KFEAT_FS
    default n
    help
      Enable /proc/kwork_stress for manually triggered long-running workqueue
      stress cases. This is a diagnostics-only interface and must remain
      disabled in normal builds.

endmenu
```

## task/kworkng/Kconfig
```kconfig
menu "Prepared Workqueue Defaults"

config WORKQUEUE_WORKERS_PER_POOL
    usize "Maximum worker tasks per CPU"
    range 1 16
    default 4
    help
      Maximum normal worker tasks managed on each boot CPU. The manager
      creates workers in task context; prepared IRQ submissions never do.
      Keep the existing symbol so saved configurations retain their limit.

config KWORKNG_NORMAL_MAX_ACTIVE
    usize "Default threaded queue release limit per CPU"
    range 1 65535
    default 256
    help
      Ready-plus-running allowance per CPU, not the worker task count or
      the number of waiting submissions. Does not activate NG services.

config KWORKNG_BH_MAX_ACTIVE
    usize "Default BH queue release limit per CPU"
    range 1 65535
    default 64
    help
      Ready-plus-running allowance per CPU and BH priority queue.
      Does not activate NG services or replace existing workqueues.

config KFEAT_WORKQUEUE_BENCH
    bool "Run prepared workqueue benchmarks and soak instead of userspace"
    default n
    help
      Run the kernel release benchmark and mixed reuse workload after boot.
      Prints results independently of log level. Powers off after completion.
      This is a test-only entry, not a workqueue implementation selector.

config WORKQUEUE_SOAK_SECONDS
    usize "Prepared workqueue soak duration in seconds"
    depends on KFEAT_WORKQUEUE_BENCH
    range 0 86400
    default 1800
    help
      Zero runs only the benchmark rounds. Use an external timeout to detect
      hangs; the duration does not bound boot, measurement or final drain.

endmenu
```

## tee/Kconfig
```kconfig
menu "Trusted Execution Environment (TEE)"

config KFEAT_TEE
    bool "Enable TEE support"
    help
      Enable the kernel's TEE integration, including TEE syscalls, task
      loading hooks, and the platform/runtime support used by current TEE
      capable targets.

if KFEAT_TEE

config KFEAT_TEE_TA_SIGN
    bool "Enable TA ELF signature verification"
    help
      Enable `.ta_signature` verification for TA ELF images loaded through the
      TEE path.

config KFEAT_VIRTCCA_HUK_KEY
    bool "Enable VirtCCA HUK key derivation"
    depends on ARCH_AARCH64
    default n
    help
      Enable the TEE hardware unique key path for ARM VirtCCA guests.
      The key is derived from the VirtCCA image key flow, so enable this
      only when running in a VirtCCA confidential guest environment.

config KFEAT_CSV_HUK_KEY
    bool "Enable CSV HUK key derivation"
    depends on ARCH_X86_64
    default n
    help
      Enable the TEE hardware unique key path for x86_64 CSV guests.
      The key is derived from the CSV sealing key flow, so enable this
      only when running in a CSV confidential guest environment.

config KFEAT_TA_VERIFY_WITH_ROOT
    bool "Enable TA ELF signature verification with root certificate"
    depends on KFEAT_TEE_TA_SIGN
    default n
    help
      Enable TA ELF signature verification using an embedded PEM root CA chain.
      The certificate is compiled into the kernel image; enable only when you
      intend to enforce chain verification against that trust anchor.

      Third-party builds may supply their own root certificate: place a PEM file
      named tee-ta-sign-root.pem under tee/tee_task_iface/certs (this path and
      filename are required for the embedded include).

      The default PEM checked in-tree is sourced from Kylin Desktop V10/V11
      certaide-kylin package file bjcasm2.p7b (converted to PEM).

endif #KFEAT_TEE


endmenu
```

## tee/tipc/Kconfig
```kconfig
menu "Trusty IPC"

config KFEAT_TIPC
    bool "Enable Trusty IPC support"
    help
      Enable the transport-independent Trusty IPC core, process-local handle
      tables, and the Trusty-compatible syscall ABI.

config KFEAT_VSOCK_TIPC_BRIDGE
    bool "Enable Trusty-compatible vsock-TIPC bridge"
    depends on KFEAT_TIPC && KFEAT_VSOCK
    help
      Enable the kernel bridge that maps selected host vsock ports to Trusty
      IPC services and exposes the Trusty vsock forwarder service to TAs.

endmenu
```

## virt/Kconfig
```kconfig
menu "Virtualization"

config KFEAT_VMM
    bool "Enable VMM (Virtual Machine Monitor)"
    help
      Enable hardware-assisted virtualization support.
      AArch64: VHE (stay in EL2 with E2H=1).
      x86_64: VMX (Intel VT-x).
      RISC-V: H-extension (HS-mode).

endmenu
```

## xtask/xconfig/examples/sample_project/kernel/Kconfig
```kconfig
config KERNEL_VERSION
	string "Kernel version"
	default "1.0.0"
	help
	  Enter the kernel version string.

config MAX_CPUS
	u32 "Maximum number of CPUs"
	default 8
	help
	  Maximum number of CPUs supported.

config MEMORY_BASE
	hex "Memory base address"
	default 0x80000000
	help
	  Base address of system memory.

config LOG_LEVEL_NUM
	u32 "Log level (0-7)"
	default 4
	help
	  Kernel log level: 0=emerg, 7=debug

config PREEMPT
	bool "Preemptible kernel"
	default n
	help
	  Enable kernel preemption.

config ADVANCED_FEATURES
	bool "Advanced kernel features"
	default n
	help
	  Enable advanced kernel features.

config SCHEDULER_RT
	bool "Real-time scheduler"
	depends on ADVANCED_FEATURES
	select PREEMPT
	help
	  Enable real-time scheduler support.
	  This automatically enables kernel preemption.

config MEMORY_HOTPLUG
	bool "Memory hotplug support"
	depends on ADVANCED_FEATURES
	help
	  Support for hot-plugging memory modules.

config PROFILING
	bool "Profiling support"
	imply ADVANCED_FEATURES
	help
	  Enable kernel profiling.
	  This implies advanced features but doesn't require them.
```

## xtask/xconfig/tests/fixtures/arch_config/Kconfig
```kconfig
mainmenu "Test Arch Config"

choice
    prompt "Target Architecture"
    default ARCH_AARCH64

config ARCH_AARCH64
    bool "AArch64 (ARM 64-bit)"

config ARCH_RISCV64
    bool "RISC-V 64-bit"

config ARCH_X86_64
    bool "x86_64"

endchoice

config ARCH
    string
    default "aarch64" if ARCH_AARCH64
    default "riscv64" if ARCH_RISCV64
    default "x86_64" if ARCH_X86_64

menu "Platform Selection"

if ARCH_AARCH64

choice
    prompt "AArch64 Platform"
    default PLATFORM_KPLAT_AARCH64

config PLATFORM_KPLAT_AARCH64
    bool "QEMU ARM64 Virtual Machine"

endchoice

config PMU_IRQ
    u32 "PMU IRQ number"
    default 23

config PSCI_METHOD
    string "PSCI method"
    default "hvc"

endif # ARCH_AARCH64

if ARCH_X86_64

choice
    prompt "x86_64 Platform"
    default PLATFORM_KPLAT_X86_64

config PLATFORM_KPLAT_X86_64
    bool "QEMU x86_64 Virtual Machine"

endchoice

endif # ARCH_X86_64

endmenu

config PLATFORM
    string
    default "kplat-aarch64" if PLATFORM_KPLAT_AARCH64
    default "kplat-x86_64" if PLATFORM_KPLAT_X86_64
```

## xtask/xconfig/tests/fixtures/basic/Kconfig
```kconfig
config TEST_BOOL
	bool "Test boolean option"
	default y

config TEST_STRING
	string "Test string option"
	default "hello"

config TEST_INT
	u32 "Test integer option"
	default 42
```

## xtask/xconfig/tests/fixtures/range_arrays/Kconfig
```kconfig
mainmenu "Test Range Array Configuration"

config TEST_RANGE_NUMBERS
    rangetype "Test numeric range"
    default [u32]
    help
      Test range with numbers

config TEST_RANGE_HEX
    rangetype "Test hex range"
    default [usize]
    help
      Test range with hex values

config TEST_RANGE_IDENTIFIERS
    rangetype "Test identifier range"
    default ["&str"]
    help
      Test range with identifiers

config TEST_RANGE_EMPTY
    rangetype "Empty range"
    default [(u64, u64)]
    help
      Test empty range (type-annotated)

config TEST_RANGE_MIXED
    rangetype "Mixed range"
    default [(u32, usize)]
    help
      Test mixed values in range
```

## xtask/xconfig/tests/fixtures/range_test/Kconfig
```kconfig
mainmenu "Range Type Test"

config TEST_RANGE_NUMBERS
    rangetype "Test numeric range"
    default [u32]
    help
      Test range with numbers

config TEST_RANGE_STRINGS
    rangetype "Test string range"
    default ["&str"]
    help
      Test range with strings

config TEST_RANGE_HEX
    rangetype "Test hex range"
    default [usize]
    help
      Test range with hex values

config TEST_RANGE_EMPTY
    rangetype "Test empty range"
    default [(u64, u64)]
    help
      Test empty range (type-annotated)

config TEST_NORMAL_INT
    u32 "Normal integer config"
    default 42
    help
      A normal integer config to verify no regressions
```
